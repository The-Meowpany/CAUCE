// Point encoding: decode(encode) must be the identity.
//
// This file exists because of a specific one-bit failure. Signing produced an R
// whose encoding differed from RFC 8032 in exactly one bit - bit 255, the parity
// of x - for a non-empty message, while the empty-message vector passed
// completely. One bit that is present in the encoding and absent from the
// signature means the arithmetic is fine and either the parity is computed from
// the wrong place or the point is the negation of the right one.
//
// These tests take `scalarMult` out of the loop entirely: they decode a known
// encoding and re-encode it. If the bit survives that round trip, decode and
// encode are correct and the fault is in the scalar ladder. If it does not, the
// fault is here and is two lines long.
//
// The vectors are generated by `docs`/`scripts`-side tooling and cross-checked
// against `cryptography`, because a mistyped hex constant in a firmware test
// compiles, runs, and is silently wrong - which is what cost four sessions on the
// signing path.
#include <cstdio>
#include <cstring>

#include <unity.h>

#include "cauce/core/Ed25519Points.h"

using cauce::ed25519BasePoint;
using cauce::ed25519DecodePoint;
using cauce::ed25519EncodePoint;
using cauce::ed25519IsOnCurve;

namespace {

struct Vector {
  const char* name;
  const char* publicKey;
  const char* sigR;
  const char* sigS;
};

const Vector kVectors[] = {
#include "point_vectors.inc"
};

void unhex(uint8_t* out, const char* text) {
  for (int i = 0; i < 32; ++i) {
    unsigned v = 0;
    std::sscanf(text + i * 2, "%2x", &v);
    out[i] = static_cast<uint8_t>(v);
  }
}

}  // namespace

// --- the round trip -----------------------------------------------------

void test_a_public_key_round_trips_through_decode_and_encode() {
  for (const Vector& v : kVectors) {
    uint8_t encoded[32], x[32], y[32], again[32];
    unhex(encoded, v.publicKey);
    TEST_ASSERT_TRUE_MESSAGE(ed25519DecodePoint(encoded, x, y), v.name);
    ed25519EncodePoint(again, x, y);
    TEST_ASSERT_EQUAL_UINT8_ARRAY(encoded, again, 32);
  }
}

void test_an_r_component_round_trips_through_decode_and_encode() {
  for (const Vector& v : kVectors) {
    if (v.sigR[0] == '\0') continue;  // BASE has no signature
    uint8_t encoded[32], x[32], y[32], again[32];
    unhex(encoded, v.sigR);
    TEST_ASSERT_TRUE_MESSAGE(ed25519DecodePoint(encoded, x, y), v.name);
    ed25519EncodePoint(again, x, y);
    TEST_ASSERT_EQUAL_UINT8_ARRAY(encoded, again, 32);
  }
}

void test_decoding_preserves_the_parity_bit_explicitly() {
  // The bit under suspicion, asserted directly rather than through the round
  // trip: encoding bit 255 must equal the parity of the decoded x.
  for (const Vector& v : kVectors) {
    uint8_t encoded[32], x[32], y[32];
    unhex(encoded, v.publicKey);
    TEST_ASSERT_TRUE(ed25519DecodePoint(encoded, x, y));
    const uint8_t signIn = static_cast<uint8_t>((encoded[31] >> 7) & 1);
    const uint8_t signOut = static_cast<uint8_t>(x[0] & 1);
    TEST_ASSERT_EQUAL_UINT8(signIn, signOut);
  }
}

void test_negating_x_flips_exactly_bit_255() {
  // The counterpart of the round trip: if x is negated, y is unchanged and the
  // encoding must differ in bit 255 and nowhere else. This is the difference
  // between the right point and its negation, which is what a one-bit signature
  // failure looks like from the outside.
  for (const Vector& v : kVectors) {
    uint8_t encoded[32], x[32], y[32], negated[32], again[32];
    unhex(encoded, v.publicKey);
    TEST_ASSERT_TRUE(ed25519DecodePoint(encoded, x, y));

    // p - x, in canonical form, by way of the field through the decoder: the
    // point (-x, y) is encoded by flipping the parity, which is the same thing
    // without needing field arithmetic here.
    negated[0] = static_cast<uint8_t>(x[0] ^ 0x01);
    std::memcpy(negated + 1, x + 1, 31);
    std::memcpy(again, y, 32);
    again[31] = static_cast<uint8_t>((again[31] & 0x7F) | ((x[0] ^ 1) << 7));

    uint8_t expected[32];
    std::memcpy(expected, encoded, 32);
    expected[31] = static_cast<uint8_t>(expected[31] ^ 0x80);
    TEST_ASSERT_EQUAL_UINT8_ARRAY(expected, again, 32);
  }
}

// --- the base point -----------------------------------------------------

void test_the_base_point_is_derived_and_matches_the_standard() {
  uint8_t x[32], y[32];
  TEST_ASSERT_TRUE(ed25519BasePoint(x, y));

  uint8_t encoded[32];
  ed25519EncodePoint(encoded, x, y);
  unhex(encoded, "5866666666666666666666666666666666666666666666666666666666666666");
  TEST_ASSERT_EQUAL_UINT8_ARRAY(encoded, encoded, 32);

  uint8_t want[32];
  unhex(want, "5866666666666666666666666666666666666666666666666666666666666666");
  uint8_t got[32];
  ed25519EncodePoint(got, x, y);
  TEST_ASSERT_EQUAL_UINT8_ARRAY(want, got, 32);
}

// --- curve membership and canonicality ----------------------------------

void test_decoded_points_are_on_the_curve() {
  for (const Vector& v : kVectors) {
    uint8_t encoded[32], x[32], y[32];
    unhex(encoded, v.publicKey);
    TEST_ASSERT_TRUE(ed25519DecodePoint(encoded, x, y));
    TEST_ASSERT_TRUE_MESSAGE(ed25519IsOnCurve(x, y), v.name);
  }
}

void test_a_non_canonical_y_is_refused() {
  // y = p is not a canonical encoding of any field element, and accepting it
  // would give one point two encodings - malleability a forger can use.
  uint8_t encoded[32] = {0};
  unhex(encoded, "edffffffffffffffffffffffffffffffffffffffffffffffffffffffffffff7f");
  uint8_t x[32], y[32];
  TEST_ASSERT_FALSE(ed25519DecodePoint(encoded, x, y));
}

void test_a_y_that_is_not_on_the_curve_is_refused() {
  // y = 2 is a canonical field element but no point on this curve has it.
  uint8_t encoded[32] = {0};
  encoded[0] = 2;
  uint8_t x[32], y[32];
  TEST_ASSERT_FALSE(ed25519DecodePoint(encoded, x, y));
}

void test_null_arguments_are_refused_rather_than_dereferenced() {
  uint8_t encoded[32] = {0};
  encoded[0] = 4;
  uint8_t x[32], y[32];
  TEST_ASSERT_FALSE(ed25519DecodePoint(nullptr, x, y));
  TEST_ASSERT_FALSE(ed25519DecodePoint(encoded, nullptr, y));
  TEST_ASSERT_FALSE(ed25519DecodePoint(encoded, x, nullptr));
  TEST_ASSERT_FALSE(ed25519BasePoint(nullptr, y));
}

void registerEd25519PointsTests() {
  RUN_TEST(test_a_public_key_round_trips_through_decode_and_encode);
  RUN_TEST(test_an_r_component_round_trips_through_decode_and_encode);
  RUN_TEST(test_decoding_preserves_the_parity_bit_explicitly);
  RUN_TEST(test_negating_x_flips_exactly_bit_255);
  RUN_TEST(test_the_base_point_is_derived_and_matches_the_standard);
  RUN_TEST(test_decoded_points_are_on_the_curve);
  RUN_TEST(test_a_non_canonical_y_is_refused);
  RUN_TEST(test_a_y_that_is_not_on_the_curve_is_refused);
  RUN_TEST(test_null_arguments_are_refused_rather_than_dereferenced);
}